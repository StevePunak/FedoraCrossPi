## meta-rpi4-custom/conf/layer.conf
```bitbake
# We have a conf and classes directory, add to BBPATH
BBPATH .= ":${LAYERDIR}"

# We have recipes-* directories, add to BBFILES
BBFILES += "${LAYERDIR}/recipes-*/*/*.bb \
            ${LAYERDIR}/recipes-*/*/*.bbappend"

BBFILE_COLLECTIONS += "meta-rpi4-custom"
BBFILE_PATTERN_meta-rpi4-custom = "^${LAYERDIR}/"
BBFILE_PRIORITY_meta-rpi4-custom = "10"

LAYERDEPENDS_meta-rpi4-custom = "core raspberrypi qt6-layer"
LAYERSERIES_COMPAT_meta-rpi4-custom = "walnascar"
```
